## gateway/firmware/sdkconfig.defaults
```kconfig
CONFIG_ESP_CONSOLE_USB_SERIAL_JTAG=y

# Переключаем размер флеш-памяти на 2 МБ
CONFIG_ESPTOOLPY_FLASHSIZE_2MB=y
CONFIG_ESPTOOLPY_FLASHSIZE="2MB"
```

## sensor/firmware/sdkconfig.defaults
```kconfig
CONFIG_ESP_CONSOLE_USB_SERIAL_JTAG=y

# Переключаем размер флеш-памяти на 2 МБ
CONFIG_ESPTOOLPY_FLASHSIZE_2MB=y
CONFIG_ESPTOOLPY_FLASHSIZE="2MB"

CONFIG_CS_GPIO=7
CONFIG_RST_GPIO=3
CONFIG_MISO_GPIO=5
CONFIG_MOSI_GPIO=6
CONFIG_SCK_GPIO=4

CONFIG_ESP_CONSOLE_USB_SERIAL_JTAG_TIMEOUT_MS=0
```
